## Kconfig
```kconfig
mainmenu "cbenchsuite module configuration"

menu "Storage adapters"
source src/storage/Kconfig
endmenu


menu "Build settings"

choice
	prompt "Build type"
	default BUILD_FINAL
config BUILD_DEBUG
	bool "Debug build"
config BUILD_FINAL
	bool "Final build"
endchoice

config CFLAGS
	string "Additional CFLAGS"
	default ""
	help
	  Additional CFLAGS used to compile. They are added to default flags for
	  Debug or Final builds.

endmenu

menu "Environment settings"
config MODULE_DIR
	string "Module directory"
	default "build/modules"
	help
	  Default module directory path
config WORK_PATH
	string "Work directory"
	default "/tmp/cbenchsuite/"
	help
	  Work directory where benchmarks will put temporary files for execution
	  or benchmarking. This can be performance critical, so it should be
	  located on a disk or ramfs you want to measure.
endmenu

menu "Execution settings"
config CONTROLLER_PRIO
	int "Controller priority"
	range -20 19
	default -20
	help
	  Scheduling priority of controller thread. Negative values require cbenchsuite
	  to be executed as root. If no root is available, cbenchsuite will still
	  execute correctly, but without this priority change.
config EXECUTION_PRIO
	int "Execution priority"
	range -20 19
	default 0
	help
	  Scheduling priority of execution threads. Negative values require cbenchsuite
	  to be executed as root. If no root is available, cbenchsuite will still
	  execute correctly, but without this priority change.
config MONITOR_PRIO
	int "Monitor priority"
	range -20 19
	default -15
	help
	  Scheduling priority of monitor thread. Negative values require cbenchsuite
	  to be executed as root. If no root is available, cbenchsuite will still
	  execute correctly, but without this priority change.
config PRINT_LOG_LEVEL
	int "Default log level"
	range 0 7
	default 6
	help
	  Default log level used in the cbenchsuite core. 0 is non at all, 7 is
	  debug level.
comment "Repeat options"
config WARMUP_RUNS
	int "Warmup runs"
	default 2
	help
	  Number of warmup runs to heat caches and reduce any loading influences.
config STDERR_PERCENT
	string "Standard error percentage"
	default "2.0"
	help
	  Beside all minimum/maximum limitations, this is the deciding factor
	  when to stop execution of a benchmark. The execution is repeated until
	  the standard error of a result value is smaller than this percentage of
	  the mean result value.

	  Higher value means worse quality of the results and less time to get them.
	  Lower value means higher result quality and slower execution.
config MIN_RUNTIME
	int "Minimum runtime per independent value (s)"
	range 0 10000000
	default 300
	help
	  CBenchsuite will repeat a benchmark at least until a runtime of
	  #independent values * minimum runtime is reached.
config MAX_RUNTIME
	int "Maximum runtime per independent value (s)"
	range 0 10000000
	default 1800
	help
	  CBenchsuite will repeat a benchmark at maximum until a runtime of
	  #independent values * maximum runtime is reached.
config MIN_RUNS
	int "Minimum number of executions per benchmark"
	range 2 10000000
	default 3
	help
	  You should only use this to make a rough limitation of runs.
config MAX_RUNS
	int "Maximum number of executions per benchmark"
	range 0 10000000
	default 1000
	help
	  You should only use this to make a rough limitation of runs. 0 is disable.

endmenu

menu "Modules"
source "modules/Kconfig"
endmenu
```

## modules/example/Kconfig
```kconfig
# Here you can define compile time options of your module. You also should
# define a config option to disable/enable building your module, for example
# 'config EXAMPLE'.
#
# If you have multiple options, start a submenu, uncomment menuconfig, if and endif
# and remove the config EXAMPLE line.

#menuconfig EXAMPLE
config EXAMPLE
	bool "Example module"
# In case your module contains benchsuites which rely on plugins from other
# modules, you should add 'select' statements so that the necessary module
# is forced to be build.
#	select OTHER_EXAMPLE_MODULE
	help
	  This is an example module help

#if EXAMPLE

# other config options here.

#endif

# In general, this is the kconfig language with all possibilities. Look at the
# kconfig-language document for more information. (libs/kconfig-frontends/doc)
```

## modules/kernel/Kconfig
```kconfig
menuconfig KERNEL
	bool "Linux kernel module"
	default y

if KERNEL

config KERNEL_MIRROR
	string "Kernel mirror for downloads"
	default "ftp://ftp.kernel.org/pub/linux/kernel/v3.x/"

endif
```

## src/storage/Kconfig
```kconfig
config STORAGE_CSV
	bool "CSV (Not finished yet)"
	default n

config STORAGE_SQLITE3
	bool "Sqlite3"
	default y
```
